## firmware/main/Kconfig.projbuild
```kconfig
# firmware/main/Kconfig.projbuild — esp-glow menuconfig options.
#
# Surfaced under Component config -> esp-glow in `idf.py menuconfig`.
#
# CFG1 (device_config.h): every option below that also appears in the CFG1
# flash-time config blob (status LED / DMX GPIOs / WiFi SSID+password /
# Art-Net fallback IP / USB-MIDI enabled / skip-WiFi) is now a DEFAULT, not
# the truth -- a valid "devcfg" partition read at boot overrides it. These
# Kconfig values only take effect when devcfg is absent or fails to parse
# (missing/corrupt/erased board), which is exactly "a dev build with
# menuconfig behaves exactly as today" (see main.cpp's app_main). The
# stock CI-built image most users flash from the browser never touches
# menuconfig at all -- the provisioner's config form writes a devcfg blob
# directly.

menu "esp-glow"

config GLOW_STATUS_LED_GPIO
    int "Status LED GPIO"
    default 2
    help
        GPIO driving the status LED. Default 2 (most ESP32-S3 devkits).
        Overridden by a valid devcfg partition's ledGpio field.

config GLOW_DMX_TX_GPIO
    int "DMX TX GPIO (RS485 DI)"
    default 17
    help
        Overridden by a valid devcfg partition's dmxTxGpio field.

config GLOW_DMX_RX_GPIO
    int "DMX RX GPIO (RS485 RO)"
    default 18
    help
        Overridden by a valid devcfg partition's dmxRxGpio field.

config GLOW_DMX_RTS_GPIO
    int "DMX RTS GPIO (RS485 DE/RE tied)"
    default 8
    help
        The UART RTS pin, which esp_dmx toggles for the DMX break/MAB and
        to drive the RS485 transceiver's DE + /RE lines (wire them together).
        Overridden by a valid devcfg partition's dmxRtsGpio field.

config GLOW_WIFI_SSID
    string "WiFi SSID"
    default "esp-glow"
    help
        Station SSID to join at boot. Set this to your LAN SSID.
        Overridden by a valid devcfg partition's wifiSsid field -- this is
        the value a dev build falls back to with no devcfg flashed.

config GLOW_WIFI_PASS
    string "WiFi password"
    default "esp-glow"
    help
        Station password for the SSID above. Overridden by a valid devcfg
        partition's wifiPass field.

config GLOW_ARTNET_BRIDGE_IP
    int "Art-Net fallback IP (packed, 0 = broadcast)"
    default 0
    help
        IPv4 used for Art-Net universes the loaded .show does not route
        explicitly (see FORMAT.md's "artnetFallbackIp" precedence note),
        packed host-byte order, e.g. 192.168.1.50 =>
        (192<<24)|(168<<16)|(1<<8)|50 = 0xC0A80132 = 3232235826. 0 means
        LAN broadcast (255.255.255.255), the Art-Net default. Overridden
        by a valid devcfg partition's artnetFallbackIp field.

config GLOW_MIDI_UART_NUM
    int "MIDI UART port number"
    default 2
    help
        UART peripheral for DIN-MIDI input. Must differ from the DMX UART
        (UART_NUM_1, see GLOW_DMX_*_GPIO) and from UART0 (console/log).

config GLOW_MIDI_RX_GPIO
    int "MIDI RX GPIO"
    default 4
    help
        GPIO wired to a standard opto-isolated MIDI IN circuit (6N137 output,
        DIN-5 pins 4/5 through the usual 220-ohm current-limiting resistors).

config GLOW_MIDI_TX_GPIO
    int "MIDI TX GPIO (-1 to disable MIDI OUT / LED feedback)"
    default -1
    help
        GPIO wired straight to a DIN-5 MIDI OUT jack (pins 4/5 through the
        usual 220-ohm resistors -- no optocoupler needed on the TX side,
        that's the receiver's job). Drives LED feedback (A5/.mdef); -1
        leaves MIDI OUT disabled and glow.led.* stays a no-op.

config GLOW_USB_MIDI_HOST
    bool "Compile in USB-MIDI host support"
    default y
    help
        Compiles usb_midi_input.cpp/usb_host_lib into the image so a
        class-compliant USB-MIDI controller can plug directly into the S3,
        instead of (or alongside) DIN-MIDI over GLOW_MIDI_RX_GPIO. Costs
        flash, not RAM or startup behavior, when unused -- no USB host
        stack initializes and no VBUS is driven unless it's actually
        turned on (see GLOW_USB_MIDI_HOST_DEFAULT_ON below and
        device_config.h's usbMidiHost flag). Default y so the stock
        browser-flashed image can always offer the flasher's "Enable
        USB-MIDI host" checkbox; turn this off only to shrink the image
        for a build that will never need the option at all.

        This is a BOARD change, not just a firmware flag: USB host mode
        means the ESP32 must supply 5V VBUS to the controller (a USB-A
        receptacle, a power path able to source a few hundred mA, ideally
        with over-current protection). One device at a time (same as
        every other input transport here); the host task runs on core 0
        with WiFi, so watch the render task's `dropped` frame counter for
        coexistence regressions after enabling this.

config GLOW_USB_MIDI_HOST_DEFAULT_ON
    bool "Enable USB-MIDI host by default (used only when no devcfg is present)"
    depends on GLOW_USB_MIDI_HOST
    default n
    help
        Whether USB-MIDI host mode actually STARTS is a runtime decision
        (device_config.h's usbMidiHost flag, set by the flasher's
        checkbox or the device console's reconfigure page) -- this option
        only supplies the fallback used when no valid devcfg partition is
        present, so a dev build driven purely by menuconfig (no CFG1 ever
        flashed) behaves exactly as the old CONFIG_GLOW_USB_MIDI_HOST
        used to: on means on. Leave this OFF on a board wired for
        GLOW_MIDI_RX_GPIO only -- it has no VBUS path to offer a
        controller, and this is the one setting that can turn USB host
        mode on with nobody having ticked a checkbox.

config GLOW_OSC_UDP_PORT
    int "OSC UDP listen port"
    default 9000
    help
        UDP port the device listens on for incoming OSC control messages
        (cue/scene/fader). 9000 matches common OSC client defaults.

config GLOW_SKIP_WIFI
    bool "Skip WiFi bring-up entirely (default, when no devcfg is present)"
    default n
    help
        Whether WiFi bring-up is skipped is now a runtime decision
        (device_config.h's skipWifi flag, CFG1 flags bit1 -- set by the
        flasher's "no WiFi" checkbox or the device console's reconfigure
        page): main.cpp checks cfg.skipWifi, not this Kconfig symbol,
        before ever calling wifi_start_sta(). This option only supplies
        the fallback used when no valid devcfg partition is present (see
        device_config.h's header comment), same "Kconfig is a default, not
        the truth" relationship as every other option in this menu.

        When it takes effect: never calls wifi_start_sta() (no STA connect
        attempt, no SoftAP fallback, no netif/lwIP bring-up). DMX output,
        the render task, and the Lua/Fennel VM (boot.fnl, live-coded cues)
        all come up and run completely independent of this -- see
        main.cpp's app_main() header comment on why WiFi is brought up
        last, not first. Art-Net output, the web console, OSC, and Pro DJ
        Link input are all network features and are skipped along with it
        (MIDI DIN stays up -- that's a UART, not network).

        Two real uses, not just one: QEMU has no WiFi/802.11 hardware
        model at all (see tests/qemu/README.md) -- esp_wifi_init()'s RF
        calibration step hangs waiting on radio status bits that emulated
        silicon never sets, so this default (or an explicit devcfg with
        skipWifi=1) is required for the QEMU boot suite to get past it.
        It's equally real for a physical rig: a purely local DMX/Fennel
        setup with no network at all, or a venue where you simply don't
        want the STA/AP surface running.

        A rig with this off already tolerates a missing or dropped AP
        without blacking out (F5's reconnect-with-backoff) -- this option
        is for never bringing WiFi up in the first place, not for handling
        it going away.

config GLOW_SELFTEST
    bool "Enable HIL selftest mode (GLOW-TEST: telemetry + serial queries)"
    default n
    help
        Emits structured "GLOW-TEST: ..." lines on the serial console (boot,
        dmx, artnet, bundle, scripts, once/sec stats, fx_disabled) and
        answers serial query commands (?dmx0, ?state, ?lua) used by the
        tests/hil/ hardware-in-the-loop suite. When no "show" partition
        bundle is present, also swaps the hardcoded demo patch for a
        deterministic one (universe 0 channel 0 = 200) so the suite's
        assertions are exact instead of demo-dependent.

        Leave this OFF for any release build: it adds a UART command-reader
        task and a chatty serial protocol that a real show has no use for.

endmenu
```

## firmware/sdkconfig.defaults
```kconfig
# sdkconfig.defaults for esp-glow (ESP32-S3 + octal PSRAM).
#
# These defaults are applied at `idf.py set-target esp32s3` time. Override
# per-board values in sdkconfig (generated) or by editing this file.

# --- Target ---
CONFIG_IDF_TARGET="esp32s3"

# --- Flash & partitioning ---
CONFIG_ESPTOOLPY_FLASHSIZE_8MB=y
CONFIG_ESPTOOLPY_FLASHSIZE="8MB"
CONFIG_PARTITION_TABLE_CUSTOM=y
CONFIG_PARTITION_TABLE_CUSTOM_FILENAME="partitions.csv"
CONFIG_PARTITION_TABLE_FILENAME="partitions.csv"

# --- Octal PSRAM (ESP32-S3) ---
# The pixel buffers and the loaded SHW1 bundle live in PSRAM. Octal mode gives
# the bandwidth the render loop needs at 44 Hz with multiple universes.
CONFIG_SPIRAM=y
CONFIG_SPIRAM_MODE_OCT=y
CONFIG_SPIRAM_TYPE_AUTO=y
CONFIG_SPIRAM_SPEED_80M=y
CONFIG_SPIRAM_USE_MALLOC=y
CONFIG_SPIRAM_MALLOC_ALWAYSINTERNAL=16384
CONFIG_SPIRAM_MALLOC_RESERVE_INTERNAL=32768
CONFIG_SPIRAM_TRY_ALLOCATE_WIFI_LWIP=y

# --- C++ runtime ---
# The core modules were written for -fno-exceptions -fno-rtti (std::vector on
# alloc failure aborts; that is acceptable with PSRAM available). The flags
# themselves are enforced in components/glow_core/CMakeLists.txt via
# target_compile_options, because sdkconfig only exposes RTTI via
# CONFIG_COMPILER_RTTI (default off) and exceptions via
# CONFIG_COMPILER_CXX_EXCEPTIONS (default off). We pin both off here too.
CONFIG_COMPILER_CXX_EXCEPTIONS=n
CONFIG_COMPILER_RTTI=n

# --- WiFi (station + softAP) ---
CONFIG_ESP_WIFI_ENABLED=y
CONFIG_ESP_WIFI_STA_DISCONNECTED_PM=y
CONFIG_ESP_WIFI_NVS_ENABLED=y
CONFIG_ESP_WIFI_SOFTAP_SUPPORT=y

# --- lwIP / sockets ---
CONFIG_LWIP_TCP=y
CONFIG_LWIP_UDP=y
CONFIG_LWIP_SO_REUSE=y
CONFIG_LWIP_MAX_SOCKETS=16

# --- HTTP server (WebSocket endpoint + console serving in F4) ---
# CONFIG_HTTPD_WS_SUPPORT gates ALL of esp_http_server's websocket API
# (httpd_ws_frame_t, HTTPD_WS_TYPE_*, httpd_ws_recv_frame/send_frame[_async],
# httpd_uri_t::is_websocket) behind #ifdef in esp_http_server.h -- without
# it, web_input.cpp's /ws handler fails to compile, not just to link.
CONFIG_HTTPD_WS_SUPPORT=y
CONFIG_HTTPD_MAX_REQ_HDR_LEN=1024
CONFIG_HTTPD_MAX_URI_LEN=512

# --- mbedTLS (OTA over HTTPS in F5) ---
CONFIG_MBEDTLS_CERTIFICATE_BUNDLE=y

# --- OTA (F5: A/B rollback) ---
# The real Kconfig symbol is bootloader-scoped (this is a bootloader
# feature, not an app one) -- CONFIG_APP_ROLLBACK_ENABLE alone is not a
# real option and idf.py silently ignores it. This is what actually makes
# "the bootloader rolls back an image that crashes before being marked
# valid" happen (see ota_manager.h for the app-level half: mandatory
# self-validation before esp_ota_mark_app_valid_cancel_rollback()).
CONFIG_BOOTLOADER_APP_ROLLBACK_ENABLE=y

# --- Task watchdog (F5 robustness) ---
# CONFIG_ESP_TASK_WDT (already present pre-F5) both enables the Task WDT
# component and initializes it at startup. CONFIG_ESP_TASK_WDT_PANIC is the
# part that actually reboots the board on timeout -- without it, a TWDT trip
# just logs which tasks stalled and the device keeps running frozen. See
# render_task.cpp for the render task's subscription (esp_task_wdt_add) and
# main.cpp's render_tick_hooks for the per-frame reset (esp_task_wdt_reset).
CONFIG_ESP_TASK_WDT=y
CONFIG_ESP_TASK_WDT_PANIC=y
CONFIG_ESP_TASK_WDT_TIMEOUT_S=10
CONFIG_ESP_TASK_WDT_CHECK_IDLE_TASK_CPU0=y
CONFIG_ESP_TASK_WDT_CHECK_IDLE_TASK_CPU1=n

# --- Core dump (F5: panic -> flash -> pull with espcoredump.py) ---
# The "coredump" partition (partitions.csv) is where this actually lands;
# without ENABLE_TO_FLASH a panic still reboots (see the Task WDT config
# above) but leaves no backtrace to pull afterward.
CONFIG_ESP_COREDUMP_ENABLE_TO_FLASH=y
CONFIG_ESP_COREDUMP_DATA_FORMAT_ELF=y

# --- Core affinity (WiFi/DMX coexistence) ---
# The render task pins itself to core 1 at runtime (xTaskCreatePinnedToCore).
# Keep WiFi/lwIP on core 0 so DMX timing on core 1 is never starved.
CONFIG_ESP_WIFI_TASK_CORE_AFFINITY_0=y
CONFIG_ESP_MAIN_TASK_AFFINITY_CPU0=y
```
